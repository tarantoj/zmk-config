## config/west.yml
```yaml
manifest:
  remotes:
    - name: zmkfirmware
      url-base: https://github.com/zmkfirmware
  projects:
    - name: zephyr
      remote: zmkfirmware
      revision: 58a5874a446ace2893a196848282d271a551e512 # v4.1.0+zmk-fixes
      clone-depth: 1
      import:
        name-allowlist:
          - cmsis
          - hal_nordic
          # - hal_rpi_pico
          # - hal_stm32
          - mbedtls
          # - tinycrypt

    # - name: zephyr
    #   remote: zmkfirmware
    #   revision: 58a5874a446ace2893a196848282d271a551e512  # v4.1.0+zmk-fixes
    #   import:
    #     name-blocklist:
    #       - ci-tools
    #       - hal_altera
    #       - hal_cypress
    #       - hal_infineon
    #       - hal_microchip
    #       - hal_nxp
    #       - hal_openisa
    #       - hal_silabs
    #       - hal_xtensa
    #       - hal_st
    #       - hal_ti
    #       - loramac-node
    #       - mcuboot
    #       - mcumgr
    #       - net-tools
    #       - openthread
    #       - edtt
    #       - trusted-firmware-m
    - name: zmk
      remote: zmkfirmware
      revision: v0.3 # main
      import: app/west.yml
  self:
    path: config
```
